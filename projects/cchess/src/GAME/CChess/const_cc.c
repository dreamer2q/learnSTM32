#include "header.h"
#include "chess.h"

// 棋盘初始设置
const s8 CC_BOARD_STARTUP[256] = {
    0, 0, 0, 0,  0,  0,  0,  0,  0,  0,  0,  0,  0, 0, 0, 0,  // 出界
    0, 0, 0, 0,  0,  0,  0,  0,  0,  0,  0,  0,  0, 0, 0, 0,  // 出界
    0, 0, 0, 0,  0,  0,  0,  0,  0,  0,  0,  0,  0, 0, 0, 0,  // 出界
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    0, 0, 0, 0,  0,  0,  0,  0,  0,  0,  0,  0,  0, 0, 0, 0,  // 出界
};

// 判断棋子是否在棋盘中的数组
const s8 CC_IN_BOARD[256] = {
    0, 0, 0, 0, 0, 0, 0, 0, 0, 0, 0, 0, 0, 0, 0, 0, 0, 0, 0, 0, 0, 0, 0, 0,
    0, 0, 0, 0, 0, 0, 0, 0, 0, 0, 0, 0, 0, 0, 0, 0, 0, 0, 0, 0, 0, 0, 0, 0,
    0, 0, 0, 1, 1, 1, 1, 1, 1, 1, 1, 1, 0, 0, 0, 0, 0, 0, 0, 1, 1, 1, 1, 1,
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    0, 0, 0, 0, 0, 0, 0, 0, 0, 0, 0, 0, 0, 0, 0, 0,
};

// 判断棋子是否在九宫的数组
const s8 CC_IN_FORT[256] = {
    0, 0, 0, 0, 0, 0, 0, 0, 0, 0, 0, 0, 0, 0, 0, 0, 0, 0, 0, 0, 0, 0, 0, 0,
    0, 0, 0, 0, 0, 0, 0, 0, 0, 0, 0, 0, 0, 0, 0, 0, 0, 0, 0, 0, 0, 0, 0, 0,
    0, 0, 0, 0, 0, 0, 1, 1, 1, 0, 0, 0, 0, 0, 0, 0, 0, 0, 0, 0, 0, 0, 1, 1,
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    0, 0, 0, 0, 0, 0, 0, 0, 0, 0, 0, 0, 0, 0, 0, 0,
};

// 判断步长是否符合特定走法的数组，1=帅(将)，2=仕(士)，3=相(象)
const s8 CC_LEGAL_SPAN[512] = {
    0, 0, 0, 0, 0, 0, 0, 0, 0, 0, 0, 0, 0, 0, 0, 0, 0, 0, 0, 0, 0, 0, 0, 0, 0,
    0, 0, 0, 0, 0, 0, 0, 0, 0, 0, 0, 0, 0, 0, 0, 0, 0, 0, 0, 0, 0, 0, 0, 0, 0,
    0, 0, 0, 0, 0, 0, 0, 0, 0, 0, 0, 0, 0, 0, 0, 0, 0, 0, 0, 0, 0, 0, 0, 0, 0,
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    0, 0, 0, 0, 0, 0, 0, 0, 0, 0, 0, 0,
};

// 根据步长判断马是否蹩腿的数组
const s8 CC_KNIGHT_PIN[512] = {
    0, 0, 0, 0, 0, 0, 0, 0, 0,  0, 0, 0,  0, 0,  0, 0, 0,   0,  0,   0, 0, 0, 0,
    0, 0, 0, 0, 0, 0, 0, 0, 0,  0, 0, 0,  0, 0,  0, 0, 0,   0,  0,   0, 0, 0, 0,
    0, 0, 0, 0, 0, 0, 0, 0, 0,  0, 0, 0,  0, 0,  0, 0, 0,   0,  0,   0, 0, 0, 0,
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    0, 0, 0, 0, 0, 0,
};

// 帅(将)的步长
const s8 CC_KING_DELTA[4] = {-16, -1, 1, 16};

// 仕(士)的步长
const s8 CC_ADVISOR_DELTA[4] = {-17, -15, 15, 17};

// 马的步长，以帅(将)的步长作为马腿
const s8 CC_KNIGHT_DELTA[4][2] = {{-33, -31}, {-18, 14}, {-14, 18}, {31, 33}};

// 马被将军的步长，以仕(士)的步长作为马腿
const s8 CC_KNIGHT_CHECK_DELTA[4][2] = {
    {-33, -18}, {-31, -14}, {14, 31}, {18, 33}};

const tImage PIECE_RES(u8 pc) {
  u8 red_side = (pc & 0x8);
  pc &= 0x7;
  if (red_side) {
    switch (pc) {
      case PIECE_ADVISOR:
        return LCD_RES_RA;
      case PIECE_BISHOP:
        return LCD_RES_RB;
      case PIECE_CANNON:
        return LCD_RES_RC;
      case PIECE_KING:
        return LCD_RES_RK;
      case PIECE_KNIGHT:
        return LCD_RES_RN;
      case PIECE_PAWN:
        return LCD_RES_RP;
      case PIECE_ROOK:
        return LCD_RES_RR;
    }
  } else {
    switch (pc) {
      case PIECE_ADVISOR:
        return LCD_RES_BA;
      case PIECE_BISHOP:
        return LCD_RES_BB;
      case PIECE_CANNON:
        return LCD_RES_BC;
      case PIECE_KING:
        return LCD_RES_BK;
      case PIECE_KNIGHT:
        return LCD_RES_BN;
      case PIECE_PAWN:
        return LCD_RES_BP;
      case PIECE_ROOK:
        return LCD_RES_BR;
    }
  }
  return LCD_RES_BOARD;
}

const char* PIECE_NAME(u8 pc) {
  if (pc == 0) {
    return "NOOP";
  }
  switch (pc & 0x7) {
    case PIECE_ADVISOR:
      return "ADVISOR";
    case PIECE_BISHOP:
      return "BISHOP";
    case PIECE_CANNON:
      return "CANNON";
    case PIECE_KING:
      return "KING";
    case PIECE_KNIGHT:
      return "KNIGHT";
    case PIECE_PAWN:
      return "PAWN";
    case PIECE_ROOK:
      return "ROOK";
    default:
      return "DEFAULT";
  }
}
